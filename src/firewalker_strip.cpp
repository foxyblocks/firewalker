// WS2812 output for the XIAO MG24, generated by SPI hardware. See firewalker_strip.h
// for the API.
//
// The strip tells a zero from a one by how long each high pulse lasts, and on this
// strip a zero stretched past roughly 400 ns reads as a one and lights a stray pixel.
// Timing those pulses in CPU code isn't reliable with the Bluetooth stack in the build:
// measured in the firmware, about one zero in 3000 came out stretched, even with
// interrupts off. So the CPU never touches the pulses. Each LED bit becomes four SPI
// bits on D10, which is SPI MOSI, and DMA feeds them to the SPI hardware, whose clock
// sets every edge. Interrupts stay on throughout, so the radio is never held up either.
//
//   3.25 MHz SPI: one SPI bit is 308 ns, so one LED bit is 1.23 us.
//     LED 0 -> 1000: 308 ns high, 923 ns low
//     LED 1 -> 1100: 615 ns high, 615 ns low
//
// The SPI peripheral also claims D8 (clock) and D9 (MISO), so leave those unconnected.
#if !defined(FIREWALKER_ADAFRUIT_STRIP_API)

#include "firewalker_strip.h"

#include <SPI.h>
#include <stdlib.h>
#include <string.h>

#include "config.h"

namespace Firewalker {

// Each LED byte becomes 8 x 4 = 32 SPI bits, and each pixel has 3 LED bytes.
static constexpr size_t ENCODED_BYTES_PER_PIXEL = 12;

// The SPI bits for each 4-bit value, most significant LED bit first. 0xC is 1100 and
// 0x8 is 1000, so each hex digit here is one LED bit.
static constexpr uint16_t ENCODED_NIBBLE[16] = {
    0x8888, 0x888C, 0x88C8, 0x88CC, 0x8C88, 0x8C8C, 0x8CC8, 0x8CCC,
    0xC888, 0xC88C, 0xC8C8, 0xC8CC, 0xCC88, 0xCC8C, 0xCCC8, 0xCCCC,
};

// Scales one channel the way Adafruit_NeoPixel does, so a brightness of 255 is
// an exact passthrough and every level below it can reach true black.
static inline uint8_t scaleChannel(uint8_t value, uint8_t brightness) {
  return (brightness == 255) ? value
                             : (uint8_t)(((uint16_t)value * (brightness + 1)) >> 8);
}

static inline uint8_t* encodeChannel(uint8_t* out, uint8_t value) {
  const uint16_t high = ENCODED_NIBBLE[value >> 4];
  const uint16_t low = ENCODED_NIBBLE[value & 0x0F];
  *out++ = (uint8_t)(high >> 8);
  *out++ = (uint8_t)high;
  *out++ = (uint8_t)(low >> 8);
  *out++ = (uint8_t)low;
  return out;
}

// The frame sits between two zero bytes. The leading one matters because the SPI hardware
// raises D10 for its first bit before its clock starts, which stretches that first high
// pulse. Every encoded LED bit starts high, so without this the first pixel's top green
// bit always reads as a one and that pixel sticks on bright green. The trailing one leaves
// D10 low for the latch. Neither is long enough for the strip to treat as a latch mid-frame.
size_t LedStrip::encodedSize() const {
  return (size_t)count_ * ENCODED_BYTES_PER_PIXEL + 2;
}

void LedStrip::begin() {
  if (!pixels_) pixels_ = (uint8_t*)calloc((size_t)count_ * 3, 1);
  if (!encoded_) encoded_ = (uint8_t*)calloc(encodedSize(), 1);

  // This transaction never ends, because the strip is the only thing on this bus.
  SPI.begin();
  SPI.beginTransaction(SPISettings(STRIP_SPI_HZ, MSBFIRST, SPI_MODE1));
}

void LedStrip::clear() {
  if (pixels_) memset(pixels_, 0, (size_t)count_ * 3);
}

void LedStrip::setPixelColor(uint16_t index, uint32_t color) {
  setPixelColor(index, (uint8_t)(color >> 16), (uint8_t)(color >> 8), (uint8_t)color);
}

void LedStrip::setPixelColor(uint16_t index, uint8_t r, uint8_t g, uint8_t b) {
  if (index >= count_ || !pixels_) return;
  uint8_t* pixel = &pixels_[(size_t)index * 3];
  pixel[0] = r;
  pixel[1] = g;
  pixel[2] = b;
}

void LedStrip::show() {
  if (!pixels_ || !encoded_) return;

  uint8_t* out = encoded_;
  *out++ = 0;
  for (uint16_t i = 0; i < count_; i++) {
    const uint8_t* pixel = &pixels_[(size_t)i * 3];
    out = encodeChannel(out, scaleChannel(pixel[1], brightness_));  // G
    out = encodeChannel(out, scaleChannel(pixel[0], brightness_));  // R
    out = encodeChannel(out, scaleChannel(pixel[2], brightness_));  // B
  }
  *out = 0;

  SPI.transfer(encoded_, encodedSize(), true);
  delayMicroseconds(STRIP_LATCH_US);
}

uint32_t LedStrip::ColorHSV(uint16_t hue, uint8_t sat, uint8_t val) {
  uint8_t r, g, b;
  hue = (hue * 1530L + 32768) / 65536;
  if (hue < 510) {
    b = 0;
    if (hue < 255) {
      r = 255;
      g = hue;
    } else {
      r = 510 - hue;
      g = 255;
    }
  } else if (hue < 1020) {
    r = 0;
    if (hue < 765) {
      g = 255;
      b = hue - 510;
    } else {
      g = 1020 - hue;
      b = 255;
    }
  } else if (hue < 1530) {
    g = 0;
    if (hue < 1275) {
      r = hue - 1020;
      b = 255;
    } else {
      r = 255;
      b = 1530 - hue;
    }
  } else {
    r = 255;
    g = b = 0;
  }
  const uint32_t v1 = 1 + val;
  const uint16_t s1 = 1 + sat;
  const uint8_t s2 = 255 - sat;
  return ((((((r * s1) >> 8) + s2) * v1) & 0xff00) << 8) |
         (((((g * s1) >> 8) + s2) * v1) & 0xff00) |
         (((((b * s1) >> 8) + s2) * v1) >> 8);
}

}  // namespace Firewalker
#endif
